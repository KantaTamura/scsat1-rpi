## pico/sample/console-hello/Kconfig
```kconfig
# SPDX-License-Identifier: Apache-2.0

mainmenu "pico-sample: console-hello"

source "Kconfig.zephyr"

module = MAIN
source "subsys/logging/Kconfig.template.log_config" # for logging
```

## pico/sample/thread/sample.yaml
```yaml
sample:
  name: zephyr thread sample
tests:
  sample.thread:
    build_only: true
    platform_allow:
      - rpi_pico
    tags:
      - uart
      - usb_device
```

## zero/meta-gcc14/conf/layer.conf
```bitbake
# We have a conf and classes directory, add to BBPATH
BBPATH .= ":${LAYERDIR}"

# We have recipes-* directories, add to BBFILES
BBFILES += "${LAYERDIR}/recipes-extended/unzip/unzip_%.bbappend \
            ${LAYERDIR}/recipes-support/libffi/libffi_%.bbappend \
            ${LAYERDIR}/recipes-core/util-linux/util-linux_%.bbappend \
            ${LAYERDIR}/recipes-devtools/pseudo/pseudo_%.bbappend \
            ${LAYERDIR}/recipes-devtools/syslinux/syslinux_%.bbappend \
            ${LAYERDIR}/recipes-devtools/xmlto/xmlto_%.bbappend \
            "

BBFILE_COLLECTIONS += "gcc14"
BBFILE_PATTERN_gcc14 = "^${LAYERDIR}/"
BBFILE_PRIORITY_gcc14 = "6"

LAYERDEPENDS_gcc14 = "core"
LAYERSERIES_COMPAT_gcc14 = "kirkstone"
```

## zero/meta-mucboot/conf/layer.conf
```bitbake
# We have a conf and classes directory, add to BBPATH
BBPATH .= ":${LAYERDIR}"

# We have recipes-* directories, add to BBFILES
BBFILES += "${LAYERDIR}/recipes-mcumgr-client/mcumgr-client/mcumgr-client_0.0.7.bb \
            "

BBFILE_COLLECTIONS += "mucboot"
BBFILE_PATTERN_mucboot = "^${LAYERDIR}/"
BBFILE_PRIORITY_mucboot = "6"

LAYERDEPENDS_mucboot = "core"
LAYERSERIES_COMPAT_mucboot = "kirkstone"

ENABLE_UART = "1"
IMAGE_INSTALL:append = " mcumgr-client"
```
